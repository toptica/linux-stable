## arch/arm/mach-mx2/Kconfig
```kconfig
if ARCH_MX2

choice
	prompt "CPUs:"
	default MACH_MX21

config MACH_MX21
	bool "i.MX21 support"
	help
	  This enables support for Freescale's MX2 based i.MX21 processor.

config MACH_MX27
	bool "i.MX27 support"
	help
	  This enables support for Freescale's MX2 based i.MX27 processor.

endchoice

comment "MX2 platforms:"

config MACH_MX21ADS
	bool "MX21ADS platform"
	depends on MACH_MX21
	select ARCH_MXC_HAS_USBH1
	select ARCH_MXC_HAS_USBH2
	select ARCH_MXC_HAS_USBOTG
	help
	  Include support for MX21ADS platform. This includes specific
	  configurations for the board and its peripherals.

config MACH_MX27ADS
	bool "MX27ADS platform"
	depends on MACH_MX27
	select ARCH_MXC_HAS_USBH1
	select ARCH_MXC_HAS_USBH2
	select ARCH_MXC_HAS_USBOTG
	help
	  Include support for MX27ADS platform. This includes specific
	  configurations for the board and its peripherals.

config MACH_PCM038
	bool "Phytec phyCORE-i.MX27 CPU module (pcm038)"
	depends on MACH_MX27
	select ARCH_MXC_HAS_USBH1
	select ARCH_MXC_HAS_USBH2
	select ARCH_MXC_HAS_USBOTG
	help
	  Include support for phyCORE-i.MX27 (aka pcm038) platform. This
	  includes specific configurations for the module and its peripherals.

config MACH_TX27
	bool "Ka-Ro electronics TX27 module"
	depends on MACH_MX27
	select MXC_ULPI
	help
	  Include support for Ka-Ro TX27 processor module

config KARO_DEBUG
	bool "Enable Ka-Ro specific debug messages"
	depends on MACH_TX27
	help
	  Compile the architecture specific files with -DDEBUG to enable
	  additional debug messages

config BASE_CLK_26MHz
	bool "Use external 26MHz oscillator"
	depends on MACH_TX27
	default y
	help
	  Unselect this option to switch off the external 26MHz oscillator
	  and use the 32.768kHz reference and i.MX27 internal FPM

choice
	prompt "Baseboard"
	depends on MACH_TX27
	default MACH_TX27_BASEBOARD_STK5

config MACH_TX27_BASEBOARD_STK5
	prompt "Ka-Ro STK5 development board"
	bool
	select ARCH_MXC_HAS_USBH2
	select ARCH_MXC_HAS_USBOTG
	help
	  This adds board specific devices that can be found on Ka-Ro's
	  STK5 evaluation board.
endchoice

config MACH_TX27_CUSTOM
	bool "Custom platform initialisation"
	depends on MACH_TX27_BASEBOARD_STK5
	help
	  Enable this option to add custom initialisation code found
	  in arch/arm/mach-mx27/stk5-custom.c

config I2C_IMX_SELECT1
	bool "Enable I2C1 module"
	default y
	depends on I2C_IMX
	help
	  Enable MX51 I2C1 module.

config I2C_IMX_SELECT2
	bool "Enable I2C2 module"
	default n
	depends on I2C_IMX
	help
	  Enable MX51 I2C2 module.

choice
	prompt "Baseboard"
	depends on MACH_PCM038
	default MACH_PCM970_BASEBOARD

config MACH_PCM970_BASEBOARD
	prompt "PHYTEC PCM970 development board"
	bool
	help
	  This adds board specific devices that can be found on Phytec's
	  PCM970 evaluation board.

endchoice

config MACH_MX27_3DS
	bool "MX27PDK platform"
	depends on MACH_MX27
	select ARCH_MXC_HAS_USBH1
	select ARCH_MXC_HAS_USBH2
	select ARCH_MXC_HAS_USBOTG
	help
	  Include support for MX27PDK platform. This includes specific
	  configurations for the board and its peripherals.

config MACH_MX27LITE
	bool "LogicPD MX27 LITEKIT platform"
	depends on MACH_MX27
	select ARCH_MXC_HAS_USBH1
	select ARCH_MXC_HAS_USBH2
	select ARCH_MXC_HAS_USBOTG
	help
	  Include support for MX27 LITEKIT platform. This includes specific
	  configurations for the board and its peripherals.

endif
```

## arch/arm/mach-mx25/Kconfig
```kconfig
if ARCH_MX25

comment "MX25 platforms:"

config MACH_MX25_3DS
	select ARCH_MXC_IOMUX_V3
	bool "Support MX25PDK (3DS) Platform"

config MACH_TX25
	select ARCH_MXC_IOMUX_V3
	bool "Support Ka-Ro electronics TX25 module"
	depends on ARCH_MX25
	help
	  Include support for Ka-Ro TX25 processor module

config KARO_DEBUG
	bool "Enable Ka-Ro specific debug messages"
	depends on MACH_TX25
	help
	  Compile the architecture specific files with -DDEBUG to enable
	  additional debug messages

config MACH_STK5_BASEBOARD
	bool "Ka-Ro Starterkit-5 (STK5) development board"
	depends on MACH_TX25
	help
	  This adds board specific devices that can be found on Ka-Ro's
	  STK5 evaluation board.
	 
config MACH_LASERBOX_MAINBOARD
	bool "TOPTICA laserbox mainboard support"
	depends on MACH_TX25
	help
	  This adds board specific devices that can be found on TOPTICA's
	  laserbox mainboard

config MACH_MLE_II_MAINBOARD
	bool "TOPTICA MLE_II mainboard support"
	depends on MACH_TX25
	help
	  This adds board specific devices that can be found on TOPTICA's
	  MLE_II mainboard

config MXC_SDMA_API
        bool "Use SDMA API"
        default y
        help
           This selects the Freescale MXC SDMA API.
           If unsure, say N.

endif
```

## arch/arm/mach-mx5/Kconfig
```kconfig
if ARCH_MX5

config ARCH_MX51
	bool
 	default y
	select CPU_V7
	select USB_ARCH_HAS_EHCI
	select MXC_TZIC

comment "MX5 platforms:"

config MACH_TX51
	bool "Support Ka-Ro electronics TX51 module"
	select ARCH_MX51
	help
	  Include support for Ka-Ro electronics GmbH TX51 module.

config KARO_DEBUG
	bool "Enable Ka-Ro specific debug messages"
	depends on MACH_TX51
	default y

choice
	prompt "Baseboard"
	depends on MACH_TX51
	default MACH_TX51_BASEBOARD_STK5

config MACH_TX51_BASEBOARD_STK5
	bool "Ka-Ro STK5 development board"
	select ARCH_MXC_HAS_USBH1
	select ARCH_MXC_HAS_USBOTG
	help
	  This adds board specific devices that can be found on Ka-Ro's
	  STK5 evaluation board.

endchoice

config MACH_TX51_CUSTOM
	bool "Custom platform initialisation"
	depends on MACH_TX51_BASEBOARD_STK5
	help
	  Enable this option to add custom initialisation code found
	  in arch/arm/mach-mx5/stk5-custom.c

menu "MX5 Options"
	depends on ARCH_MX5

config FORCE_MAX_ZONEORDER
	int "MAX_ORDER"
	default "13"

config MXC_SDMA_API
        bool "Use SDMA API"
        default y
        help
           This selects the Freescale MXC SDMA API.
           If unsure, say N.

config ARCH_MXC_HAS_NFC_V3
        bool "MXC NFC Hardware Version 3"
        depends on ARCH_MX51
        default y
        help
           This selects the Freescale MXC Nand Flash Controller Hardware Version 3
           If unsure, say N.

config ARCH_MXC_HAS_NFC_V3_2
        bool "MXC NFC Hardware Version 3.2"
        depends on ARCH_MXC_HAS_NFC_V3
        default y
        help
           This selects the Freescale MXC Nand Flash Controller Hardware Version 3.1
           If unsure, say N.

menu "SDMA options"
        depends on MXC_SDMA_API

config SDMA_IRAM
        bool "Use Internal RAM for SDMA transfer"
        default n
	help
           Support Internal RAM as SDMA buffer or control structures

config SDMA_IRAM_SIZE
        hex "Reserved bytes of IRAM for SDMA (0x800-0x1000)"
        range 0x800 0x1000
        depends on SDMA_IRAM
        default "0x1000"
        help
           Set the size of IRAM for SDMA. It must be a multiple of 512bytes.
endmenu

menu "Device options"

config I2C_IMX_SELECT1
	bool "Enable I2C1 module"
	default y
	depends on I2C_IMX
	help
	  Enable MX51 I2C1 module.

config I2C_IMX_SELECT2
	bool "Enable I2C2 module"
	default n
	depends on I2C_IMX
	help
	  Enable MX51 I2C2 module.

config I2C_IMX_SELECT3
	bool "Enable I2C3 module"
	default n
	depends on I2C_IMX
	help
	  Enable MX51 I2C3 module.

endmenu

endmenu

endif
```

## arch/arm/plat-mxc/Kconfig
```kconfig
if ARCH_MXC

menu "Freescale MXC Implementations"

choice
	prompt "Freescale CPU family:"
	default ARCH_MX3

config ARCH_MX1
	bool "MX1-based"
	select CPU_ARM920T
	select COMMON_CLKDEV
	help
	  This enables support for systems based on the Freescale i.MX1 family

config ARCH_MX2
	bool "MX2-based"
	select CPU_ARM926T
	select COMMON_CLKDEV
	select USB_ARCH_HAS_EHCI
	help
	  This enables support for systems based on the Freescale i.MX2 family

config ARCH_MX25
	bool "MX25-based"
	select CPU_ARM926T
	select COMMON_CLKDEV
	select USB_ARCH_HAS_EHCI
	help
	  This enables support for systems based on the Freescale i.MX25 family

config ARCH_MX3
	bool "MX3-based"
	select CPU_V6
	select COMMON_CLKDEV
	select USB_ARCH_HAS_EHCI
	help
	  This enables support for systems based on the Freescale i.MX3 family

config ARCH_MX5
	bool "MX5-based"
	select CPU_V7
	select COMMON_CLKDEV
	select USB_ARCH_HAS_EHCI
	help
	  This enables support for systems based on the Freescale i.MX5 family

endchoice

source "arch/arm/mach-mx1/Kconfig"
source "arch/arm/mach-mx2/Kconfig"
source "arch/arm/mach-mx3/Kconfig"
source "arch/arm/mach-mx25/Kconfig"
source "arch/arm/mach-mx5/Kconfig"

endmenu

config MXC_IRQ_PRIOR
	bool "Use IRQ priority"
	depends on ARCH_MXC
	help
	  Select this if you want to use prioritized IRQ handling.
	  This feature prevents higher priority ISR to be interrupted
	  by lower priority IRQ even IRQF_DISABLED flag is not set.
	  This may be useful in embedded applications, where are strong
	  requirements for timing.
	  Say N here, unless you have a specialized requirement.

config MXC_TZIC
	bool
	depends on ARCH_MXC

config MXC_PWM
	tristate "Enable PWM driver"
	depends on ARCH_MXC
	select HAVE_PWM
	help
	  Enable support for the i.MX PWM controller(s).

config MXC_ULPI
	bool

config ARCH_HAS_RNGA
	bool
	depends on ARCH_MXC

config ARCH_MXC_IOMUX_V3
	bool

config MXC_AUDMUX
	bool "Enable AUDMUX driver"
	select MX2_AUDMUX if ARCH_MX2
	select MXC_AUDMUX_V3 if (ARCH_MX25 || ARCH_MX3 || ARCH_MX5)
	help
	  Enable support for the i.MX AUDMUX (Digital Audio Mux).

config MX2_AUDMUX
	bool
	depends on MXC_AUDMUX

config MXC_AUDMUX_V3
	bool
	depends on MXC_AUDMUX

config MXC_SSI_PORTS
	bool "Generic SSI Layer"
	depends on ARCH_MXC
	help
	  This option enables the generic SSI layer that makes it possible to
	  write drivers that decide at runtime which SSI port to use.
	  Since the SSI signals must be routed through the AUDMUX, there is no
	  reason to hardwire any driver that utilizes the SSI interface to a specific
	  SSI port.

endif
```

## drivers/staging/mxc-ipu/Kconfig
```kconfig
config FB_MXC_IPU_V3
	tristate "Freescale i.MX IPU framebuffer driver"
	depends on ARCH_MX3 || ARCH_MX5
	select FB_CFB_FILLRECT
	select FB_CFB_COPYAREA
	select FB_CFB_IMAGEBLIT
	select MXC_IPU
	help
	  This is a framebuffer driver for the i.MX37 and i.MX51 Image Processing Unit (IPU).

config FB_MXC_DEBUG
       bool	"Enable Debugging"
       depends on FB_MXC_IPU_V3

config MXC_IPU
	bool
	depends on !MACH_MX21
	depends on !MACH_MX27
	depends on !ARCH_MX25
	select MXC_IPU_V1 if !ARCH_MX37 && !ARCH_MX51
	select MXC_IPU_V3 if ARCH_MX37 || ARCH_MX51
	select MXC_IPU_V3D if ARCH_MX37
	select MXC_IPU_V3EX if ARCH_MX51

config MXC_IPU_V3
	bool

config MXC_IPU_V3D
	bool

config MXC_IPU_V3EX
	bool
```

## drivers/staging/mxc-v4l/Kconfig
```kconfig
menuconfig VIDEO_MXC
	tristate "Support video post-processing hardware on i.MX"
	depends on ARCH_MXC
	select VIDEO_DEV

config VIDEO_MXC_OUTPUT
	tristate "MXC Video For Linux Video Output"
	depends on VIDEO_MXC
	---help---
	  This is the video4linux2 output driver based on MXC IPU/eMMA module.

if VIDEO_MXC_OUTPUT

source "drivers/staging/mxc-v4l/output/Kconfig"

endif
```

## drivers/staging/mxc-v4l/output/Kconfig
```kconfig
config VIDEO_MXC_OUTPUT_DEBUG
	bool "Verbose MXC video output debugging"
	depends on VIDEO_MXC_OUTPUT
	default n

config VIDEO_MXC_IPU_OUTPUT
	tristate
	depends on VIDEO_MXC_OUTPUT && MXC_IPU
	default y
	---help---
	  This is the video4linux2 driver for IPU post processing video output.

config VIDEO_MXC_EMMA_OUTPUT
	tristate
	depends on VIDEO_MXC_OUTPUT && ARCH_MX2 && FB_IMX
	default y
	---help---
	  This is the video4linux2 driver for EMMA post processing video output.
```

## sound/arm/Kconfig
```kconfig
# ALSA ARM drivers

menuconfig SND_ARM
	bool "ARM sound devices"
	depends on ARM
	default y
	help
	  Support for sound devices specific to ARM architectures.
	  Drivers that are implemented on ASoC can be found in
	  "ALSA for SoC audio support" section.

if SND_ARM

config SND_ARMAACI
	tristate "ARM PrimeCell PL041 AC Link support"
	depends on ARM_AMBA
	select SND_PCM
	select SND_AC97_CODEC

config SND_PXA2XX_PCM
	tristate
	select SND_PCM

config SND_PXA2XX_LIB
	tristate
	select SND_AC97_CODEC if SND_PXA2XX_LIB_AC97

config SND_PXA2XX_LIB_AC97
	bool

config SND_PXA2XX_AC97
	tristate "AC97 driver for the Intel PXA2xx chip"
	depends on ARCH_PXA
	select SND_PXA2XX_PCM
	select SND_AC97_CODEC
	select SND_PXA2XX_LIB
	select SND_PXA2XX_LIB_AC97
	help
	  Say Y or M if you want to support any AC97 codec attached to
	  the PXA2xx AC97 interface.

config SND_MX27_PCM
	tristate
	depends on ARCH_MX2
	select SND_PCM

config SND_MX25_PCM
	tristate
	depends on ARCH_MX25
	select SND_PCM

config SND_MX51_PCM
	tristate
	depends on ARCH_MX51
	select SND_PCM

config SND_MXC_AC97
	tristate "AC97 driver for the Freescale i.MX chips"
	depends on ARCH_MXC && SND
	select MXC_AUDMUX
	select MXC_SSI_PORTS
	select SND_MX27_PCM if ARCH_MX2
	select SND_MX25_PCM if ARCH_MX25
	select SND_MX51_PCM if ARCH_MX51
	select SND_AC97_CODEC
	help
	  Say Y or M if you want to support any AC97 codec attached to
	  the i.MX27 or i.MX25 SSI interface configured for AC97 operation.
endif	# SND_ARM
```
